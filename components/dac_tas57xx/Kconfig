## components/dac_tas57xx/Kconfig
```kconfig
if DAC_TAS57XX

    choice TAS57XX_HYBRID_FLOW
        prompt "DSP hybrid flow configuration"
        default TAS57XX_HF1
        help
            Select which PurePath Console hybrid flow to load at boot.

        config TAS57XX_HF1
            bool "HF1 (tt_hf1)"
            help
                Load the HF1 hybrid flow configuration.

        config TAS57XX_HF6
            bool "HF6 (tt_hf6)"
            help
                Load the HF6 hybrid flow configuration.

    endchoice

    config TAS57XX_MAX_VOLUME
        int "Maximum DAC volume (dB)"
        range -100 0
        default -30
        help
            Maximum volume level in dB that corresponds to AirPlay volume 0 dB.
            The TAS57xx register range is 0 dB to -127 dB.
            A value of -30 means AirPlay full volume maps to -30 dB on the DAC.

endif # DAC_TAS57XX
```

## sdkconfig.defaults.bt
```kconfig
# Bluetooth A2DP Sink defaults (ESP32 Classic BT only)
# Include this in sdkconfig for boards that support Classic Bluetooth.
# These options are ignored on ESP32-S3/C3/etc which lack Classic BT.
#
# To enable: Component config → Bluetooth → then these are set automatically.
# The A2DP_SINK_ENABLED option appears under "Airplay ESP Configuration → Bluetooth A2DP Sink".

CONFIG_BT_ENABLED=y
CONFIG_BTDM_CTRL_MODE_BR_EDR_ONLY=y
CONFIG_BT_BLUEDROID_ENABLED=y
CONFIG_BT_CLASSIC_ENABLED=y
CONFIG_BT_A2DP_ENABLE=y
CONFIG_A2DP_SINK_ENABLED=y
CONFIG_ESP_COEX_SW_COEXIST_ENABLE=y

# Reduce IRAM usage: WiFi ISR optimisations moved to flash (saves ~12 KB)
CONFIG_ESP_WIFI_IRAM_OPT=n
CONFIG_ESP_WIFI_RX_IRAM_OPT=n

# Compiler optimization — use size optimization to reduce IRAM pressure
# (especially important when BT is enabled on ESP32)
CONFIG_COMPILER_OPTIMIZATION_SIZE=y

# Reduce IRAM usage: move non-critical code to flash
CONFIG_FREERTOS_PLACE_FUNCTIONS_INTO_FLASH=y
CONFIG_RINGBUF_PLACE_FUNCTIONS_INTO_FLASH=y
CONFIG_BTDM_CTRL_HLI=n
CONFIG_HEAP_PLACE_FUNCTION_INTO_FLASH=y
```
